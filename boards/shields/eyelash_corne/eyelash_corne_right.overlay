/*
*
* Copyright (c) 2024 The ZMK Contributors
* SPDX-License-Identifier: MIT
*
*/

#include "eyelash_corne.dtsi"
#include <behaviors/battery_history_request.dtsi>

&default_transform {
    col-offset = <7>;
};
/*
 * The halves' PCBs are mirrored, so the two panels sit 180 degrees apart.
 * Cancel that here, on one half only, so a single rotation in code serves both
 * (display/canvas.h). If both halves come out upside down, move this block to
 * eyelash_corne_left.overlay -- it is the same one-line change either way.
 */
&oled {
    segment-remap;
    com-invdir;
};
